## config/boards/shields/Stratus75vBETA/Kconfig.defconfig
```kconfig
if SHIELD_STRATUS75VBETA

config ZMK_KEYBOARD_NAME
    default "Stratus75vBETA"

endif
```

## config/boards/shields/Stratus75vBETA/Kconfig.shield
```kconfig
config SHIELD_STRATUS75VBETA
    def_bool $(shields_list_contains,Stratus75vBETA)
```
